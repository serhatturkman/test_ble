&pinctrl {

    /* PDM microphone interface */
    pdm0_default_alt: pdm0_default_alt {
        group1 {
            psels = <NRF_PSEL(PDM_CLK, 0, 25)>,
                    <NRF_PSEL(PDM_DIN, 0, 24)>;
            nordic,drive-mode = <NRF_DRIVE_H0H1>;
        };
    };
};
