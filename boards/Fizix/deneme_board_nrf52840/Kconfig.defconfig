## boards/Fizix/deneme_board_nrf52840/Kconfig.defconfig
```kconfig
if BOARD_DENEME_BOARD_NRF52840

config BOARD
    default "deneme_board_nrf52840"

config NORDIC_QSPI_NOR
    bool
    default y

config SYS_CLOCK_EXISTS
    bool
    default y

if USB_DEVICE_STACK

config USB_NRFX
    default y

endif # USB_DEVICE_STACK

config UART_NRFX
    default y

config ADC_NRFX_SAADC
    default y


endif # BOARD_DENEME_BOARD_NRF52840
```

## boards/Fizix/deneme_board_nrf52840/board.yml
```yaml
board:
  name: deneme_board_nrf52840
  full_name: Deneme Board nRF52840
  vendor: Fizix
  socs:
    - name: nrf52840
```

## boards/Fizix/deneme_board_nrf52840/deneme_board_nrf52840_defconfig
```kconfig
# Enable MPU
CONFIG_ARM_MPU=y

# Enable hardware stack protection
CONFIG_HW_STACK_PROTECTION=y


CONFIG_PRINTK=y
CONFIG_HEAP_MEM_POOL_SIZE=256
```

## central_smp_client/Kconfig
```kconfig
menu "Zephyr"
source "Kconfig.zephyr"

config NCS_SAMPLES_DEFAULTS
    bool "Enable NCS sample default settings"
    default n
    imply LOG
    imply LOG_DEFAULT_MINIMAL
    imply ASSERT
    imply ASSERT_NO_COND_INFO
    imply ASSERT_NO_MSG_INFO
    imply HW_STACK_PROTECTION if ARCH_HAS_STACK_PROTECTION
    help
      Use the default configuration for NCS samples.

config BT_GATT_DM
	bool "GATT Discovery Manager library"
	help
	  Enable BLE GATT Discovery Manager library

config BT_DFU_SMP
	bool "DFU SMP service client"
	select BT_NRF_SERVICES
	help
	  Enable GATT DFU SMP Service Client.

config BT_SCAN
    bool "Scan library"
    default n
    depends on BT_CENTRAL && BT
    help
      Enable BLE Scan library

config BT_SCAN_FILTER_ENABLE
    bool "Enabling filters for the Scan library."
    default n
    depends on BT_SCAN && BT
    help
      Enabling filters for the Scan library.

config BT_SCAN_UUID_CNT
    int "Number of filters for UUIDs."
    default 0
    depends on BT_SCAN_FILTER_ENABLE && BT_SCAN && BT
    help
      Number of filters for UUIDs

config DK_LIBRARY
    bool "Button and LED Library for Nordic DKs"
    select GPIO

endmenu

module = Central SMP Client
module-str = Central SMP Client
source "subsys/logging/Kconfig.template.log_config"
```
